## boards/microchip/curi_nano/Kconfig.curi_nano
```kconfig
# Copyright (c) 2020 Google LLC.
# Copyright (c) 2024 Gerson Fernando Budke <nandojve@gmail.com>
# SPDX-License-Identifier: Apache-2.0

config BOARD_CURI_NANO
	select SOC_SAME51J20A
```

## boards/microchip/curi_nano/board.yml
```yaml
board:
  name: curi_nano
  full_name: curi nano
  vendor: adafruit
  socs:
    - name: samd51g19a
```

## boards/rtthread/art_pi_2/Kconfig.art_pi_2
```kconfig
# Copyright (c) 2024 STMicroelectronics
# SPDX-License-Identifier: Apache-2.0

config BOARD_ART_PI_2
	select SOC_STM32H7R7XX
```

## boards/rtthread/art_pi_2/board.yml
```yaml
board:
  name: art_pi_2
  full_name: ART PI 2
  vendor: st
  socs:
    - name: stm32h7r7xx
```

## boards/ruiside/art_pi2/Kconfig.defconfig
```kconfig
if BT

# choice AIROC_PART
# 	default CYW43438
# endchoice

# choice CYW4343W_MODULE
# 	default CYW4343W_MURATA_1DX
# endchoice
choice AIROC_PART
	default CYW4343W
endchoice

choice CYW4343W_MODULE
	default CYW4343W_MURATA_1DX
endchoice
endif # BT
```

## boards/ruiside/ra8d1_vision_board/Kconfig.defconfig
```kconfig
# Copyright (c) 2025 Shan Pen <bricle031@gmail.com>
# SPDX-License-Identifier: Apache-2.0

if BOARD_RA8D1_VISION_BOARD

if DISK_DRIVER_SDMMC

config SD_CMD_TIMEOUT
	default 1000

endif # DISK_DRIVER_SDMMC

endif # BOARD_RA8D1_VISION_BOARD
# config MIPI_DSI
# 	default y

if DISPLAY


config MEMC
	default y

config RENESAS_RA_GLCDC_FRAME_BUFFER_SECTION
	default ".sdram"
	depends on RENESAS_RA_GLCDC


endif # DISPLAY
```

## boards/ruiside/rt_spark/Kconfig.defconfig
```kconfig
# black_f407zg board configuration

# Copyright (c) 2020 Intel Corporation
# SPDX-License-Identifier: Apache-2.0

if BOARD_RT_SPARK

config SPI_STM32_INTERRUPT
	default y
	depends on SPI

config MIPI_DBI_STM32_FMC_MEM_BARRIER
	default n if MIPI_DBI_STM32_FMC

if DISPLAY

choice ST7789V_PIXEL_FORMAT
	default ST7789V_BGR565
endchoice

endif # DISPLAY

endif # BOARD_RT_SPARKs
```

## boards/ruiside/rt_spark/Kconfig.rt_spark
```kconfig
# Copyright (c) 2020 Intel Corporation
# SPDX-License-Identifier: Apache-2.0

config BOARD_RT_SPARK
	select SOC_STM32F407XG
```

## boards/ruiside/rt_spark/board.yml
```yaml
board:
  name: rt_spark
  full_name: Rt-Thread Spark Spark No. 1 Development Board
  vendor: others
  socs:
    - name: stm32f407xx
```

## dts/bindings/sensor/aosong,dht21.yaml
```yaml
# Copyright The Zephyr Project Contributors
# SPDX-License-Identifier: Apache-2.0

description: |
    Aosong AHT21 (Digital-output Humidity and Temperature Sensor)

    The Aosong AHT21 sensor provides temperature and humidity
    measurements through an I2C bus.

compatible: "aosong,aht21"

include: [sensor-device.yaml, i2c-device.yaml]
```
